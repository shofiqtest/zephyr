## drivers/sensor/adi/max30001/Kconfig
```kconfig
# Copyright (c) 2026 Md Shofiqul Islam
# SPDX-License-Identifier: Apache-2.0
#
# This file contains the binding for the MAX30001 ECG/BioZ AFE

config MAX30001
	bool "MAX30001 ECG and bio-impedance AFE"
	default y
	depends on DT_HAS_ADI_MAX30001_ENABLED
	select SPI
	help
	  Enable driver for the MAX30001 ultra-low-power single-channel ECG
	  and bio-impedance (BioZ) analog front-end.

	  This initial driver covers ECG sample acquisition and a
	  provisional BioZ voltage path. BioZ drive-current (CGMAG)
	  configuration and impedance-in-ohms conversion are not yet
	  implemented.
```

## dts/bindings/sensor/adi,max30001.yaml
```yaml
# Copyright (c) 2026 Md Shofiqul Islam
# SPDX-License-Identifier: Apache-2.0

description: |
  Analog Devices MAX30001 ultra-low-power, single-channel ECG and
  bio-impedance (BioZ) analog front-end.

  Datasheet: https://www.analog.com/media/en/technical-documentation/data-sheets/max30001.pdf

  This binding/driver pair covers the ECG acquisition path (register map
  and conversion formula verified against the MAX30003 reference driver
  and ADI's own EngineerZone documentation) and a first-pass BioZ voltage
  path (register map, FIFO format and gain encoding verified against the
  Protocentral MAX30001 Arduino library, not yet independently verified
  against ADI's own datasheet since that fetch timed out repeatedly this
  session). BioZ drive-current configuration (CGMAG) and impedance-in-ohms
  conversion are NOT implemented -- no verified per-code drive-current
  table was found, only a vague 55 nA - 96 uA range from a web search.

compatible: "adi,max30001"

include: [sensor-device.yaml, spi-device.yaml]

properties:
  reset-gpios:
    type: phandle-array
    description: |
      Optional hardware reset pin (active-low per the datasheet pinout).
      If not provided, the driver issues a software reset (SW_RST register)
      instead during init.
```

## dts/bindings/sensor/maxim,max30101.yaml
```yaml
# Device Tree binding for Maxim MAX30101
#
# Copyright (c) 2018, NXP
# Copyright (c) 2025, CATIE
#
# SPDX-License-Identifier: Apache-2.0

description: MAX30101 heart rate and pulse oximeter sensor

compatible: "maxim,max30101"

include: maxim,max3010x-common.yaml

properties:
  led-pa:
    type: uint8-array
    default: [0xff, 0xff, 0xff]
    description: |
      Set the pulse amplitude to control the LED current.
      [0]: Red LED
      [1]: IR LED
      [2]: Green LED
      Default set to [0xff, 0xff, 0xff], activate any chosen LED channel.
      Value range: 0x00 - 0xFF | 0.0 mA - 50.0 mA
```

## dts/bindings/sensor/maxim,max30102.yaml
```yaml
# Device Tree binding for Maxim MAX30102
#
# Copyright (c) 2026, Md Shofiqul Islam
#
# SPDX-License-Identifier: Apache-2.0

description: |
  MAX30102 heart rate and pulse oximeter sensor.

  The MAX30102 has two LED channels (Red + IR) and is register-compatible
  with the MAX30101 except that the Green LED (LED3) is not present.

compatible: "maxim,max30102"

include: maxim,max3010x-common.yaml

properties:
  led-pa:
    type: uint8-array
    default: [0xff, 0xff]
    description: |
      Set the pulse amplitude to control the LED current.
      [0]: Red LED
      [1]: IR LED
      The MAX30102 has no Green LED. Array must have exactly 2 elements.
      Value range: 0x00 - 0xFF | 0.0 mA - 50.0 mA
```
